## base_external/package/aesd-assignments/Config.in
```kconfig
config BR2_PACKAGE_AESD_ASSIGNMENTS
	bool "aesd-assignments"
	help
	  Contains finder-app, writer and test scripts from Assignment 3.
```
